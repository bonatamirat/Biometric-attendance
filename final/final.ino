#include <Adafruit_Fingerprint.h>
#include <SoftwareSerial.h>
#include <Wire.h>
#include <Adafruit_GFX.h>
#include <Adafruit_SSD1306.h>
#include <ESP8266WiFi.h>
#include <ESP8266WebServer.h>
#include <NTPClient.h>
#include <WiFiUdp.h>

// Wi-Fi credentials
const char* ssid = "bona";
const char* password = "1234567888";

// HTTP server
ESP8266WebServer server(80);

// NTP Client for time
WiFiUDP ntpUDP;
NTPClient timeClient(ntpUDP, "pool.ntp.org", 10800, 60000); // EAT = UTC+3 (10800 seconds)

// Pin definitions
#define Finger_Rx D1
#define Finger_Tx D2
#define OLED_SCL D5
#define OLED_SDA D6

// OLED settings
#define SCREEN_WIDTH 128
#define SCREEN_HEIGHT 64
#define OLED_RESET -1
Adafruit_SSD1306 display(SCREEN_WIDTH, SCREEN_HEIGHT, &Wire, OLED_RESET);

// Fingerprint sensor
SoftwareSerial mySerial(Finger_Rx, Finger_Tx);
Adafruit_Fingerprint finger = Adafruit_Fingerprint(&mySerial);

// Bitmap definitions from the example code
#define Wifi_start_width 54
#define Wifi_start_height 49
const uint8_t PROGMEM Wifi_start_bits[] = {
  0x00,0x00,0x00,0x00,0x00,0x00,0x00,0x00,0x00,0x00,0x00,0x00,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0x00
};

#define Wifi_connected_width 63
#define Wifi_connected_height 49
const uint8_t PROGMEM Wifi_connected_bits[] = {
  0x00,0x00,0x00,0x00,0x00,0x00,0x00,0x00,0x00,0x00,0x00,0x00,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0x00
};

#define FinPr_start_width 64
#define FinPr_start_height 64
const uint8_t PROGMEM FinPr_start_bits[] = {
  0x00,0x00,0x00,0x1f,0xe0,0x00,0x00,0x00,0x00,0x00,0x01,0xff,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0x00
};

#define FinPr_valid_width 64
#define FinPr_valid_height 64
const uint8_t PROGMEM FinPr_valid_bits[] = {
  0x00,0x00,0x03,0xfe,0x00,0x00,0x00,0x00,0x00,0x00,0x1f,0xff,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0x00
};

#define FinPr_invalid_width 64
#define FinPr_invalid_height 64
const uint8_t PROGMEM FinPr_invalid_bits[] = {
  0x00,0x00,0x03,0xfe,0x00,0x00,0x00,0x00,0x00,0x00,0x1f,0xff,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0x00
};

#define FinPr_failed_width 64
#define FinPr_failed_height 64
const uint8_t PROGMEM FinPr_failed_bits[] = {
  0x00,0x00,0x3f,0xe0,0x00,0x00,0x00,0x00,0x00,0x01,0xff,0xfe,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0xfe
};

#define FinPr_scan_width 64
#define FinPr_scan_height 64
const uint8_t PROGMEM FinPr_scan_bits[] = {
  0x00,0x00,0x00,0x00,0x00,0x00,0x00,0x00,0x00,0x00,0x00,0x00,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0x00
};
void setup() {
  Serial.begin(9600);
  delay(100);

  // Initialize OLED
  Wire.begin(OLED_SDA, OLED_SCL);
  if (!display.begin(SSD1306_SWITCHCAPVCC, 0x3C)) {
    Serial.println(F("SSD1306 allocation failed"));
    for (;;);
  }
  display.clearDisplay();
  display.setTextSize(2); // Bold text
  display.setTextColor(SSD1306_WHITE);
  display.setCursor(0, 0);
  display.println(F("Biometric"));
  display.drawBitmap(32, 16, FinPr_start_bits, FinPr_start_width, FinPr_start_height, SSD1306_WHITE); // Fingerprint icon
  display.display();
  delay(2000);

  // Connect to Wi-Fi
  WiFi.begin(ssid, password);
  display.clearDisplay();
  display.setTextSize(2); // Bold text
  display.setCursor(0, 0);
  display.println(F("WiFi..."));
  display.drawBitmap(37, 15, Wifi_start_bits, Wifi_start_width, Wifi_start_height, SSD1306_WHITE); // Wi-Fi start icon
  display.display();
  while (WiFi.status() != WL_CONNECTED) {
    delay(500);
    Serial.print(".");
  }
  Serial.println("\nWiFi connected: " + WiFi.localIP().toString());
  display.clearDisplay();
  display.setTextSize(2); // Bold text
  display.setCursor(0, 0);
  display.println(F("WiFi OK"));
  display.setTextSize(1);
  display.println(WiFi.localIP());
  display.drawBitmap(32, 15, Wifi_connected_bits, Wifi_connected_width, Wifi_connected_height, SSD1306_WHITE); // Wi-Fi connected icon
  display.display();
  delay(2000);

  // Initialize NTP client
  timeClient.begin();
  timeClient.update();
  Serial.println("Time: " + timeClient.getFormattedTime());

  // Initialize fingerprint sensor
  finger.begin(57600);
  if (finger.verifyPassword()) {
    Serial.println("Found fingerprint sensor!");
    display.clearDisplay();
    display.setTextSize(2); // Bold text
    display.setCursor(0, 0);
    display.println(F("Sensor OK"));
    display.drawBitmap(32, 16, FinPr_valid_bits, FinPr_valid_width, FinPr_valid_height, SSD1306_WHITE); // Valid icon
    display.display();
  } else {
    Serial.println("Did not find fingerprint sensor :(");
    display.clearDisplay();
    display.setTextSize(2); // Bold text
    display.setCursor(0, 0);
    display.println(F("Sensor Err"));
    display.drawBitmap(32, 16, FinPr_failed_bits, FinPr_failed_width, FinPr_failed_height, SSD1306_WHITE); // Failed icon
    display.display();
    while (1) { delay(1); }
  }

  // Set up HTTP server routes
  server.on("/control", HTTP_POST, handleControl);
  server.on("/test", HTTP_GET, []() {
    Serial.println("Test endpoint called");
    server.send(200, "text/plain", "Test OK");
  });
  server.begin();
  Serial.println("HTTP server started");
  display.clearDisplay();
  display.setTextSize(2); // Bold text
  display.setCursor(0, 0);
  display.println(F("Server OK"));
  display.drawBitmap(32, 16, FinPr_valid_bits, FinPr_valid_width, FinPr_valid_height, SSD1306_WHITE); // Valid icon
  display.display();
}

void loop() {
  server.handleClient();
  timeClient.update();
  static unsigned long lastCheck = 0;
  if (millis() - lastCheck > 5000) {
    if (finger.verifyPassword()) {
      Serial.println("Sensor OK");
    } else {
      Serial.println("Sensor disconnected");
    }
    lastCheck = millis();
  }
}

void handleControl() {
  Serial.println("Control endpoint called");
  String action = server.arg("action");
  String response;

  if (action == "enroll") {
    String name = server.arg("name");
    uint8_t id = server.arg("fingerprint_id").toInt();
    Serial.println("Enroll request: Name=" + name + ", ID=" + String(id));
    if (id > 0 && id <= 127 && name != "") {
      String enrollResult = enrollFingerprint(id);
      if (enrollResult == "success") {
        response = "{\"status\":\"success\",\"message\":\"Enrolled ID #" + String(id) + "\"}";
      } else {
        response = "{\"status\":\"error\",\"message\":\"Enrollment failed: " + enrollResult + "\"}";
      }
    } else {
      response = "{\"status\":\"error\",\"message\":\"Invalid data\"}";
    }
  } else if (action == "attendance") {
    Serial.println("Attendance request");
    if (markAttendance()) {
      response = "{\"status\":\"success\",\"message\":\"" + String(finger.fingerID) + "\"}";
    } else {
      response = "{\"status\":\"error\",\"message\":\"Fingerprint not found\"}";
    }
  } else if (action == "delete") {
    uint8_t id = server.arg("fingerprint_id").toInt();
    Serial.println("Delete request: ID=" + String(id));
    if (id > 0 && id <= 127) {
      if (deleteFingerprint(id)) {
        response = "{\"status\":\"success\",\"message\":\"Deleted ID #" + String(id) + "\"}";
      } else {
        response = "{\"status\":\"error\",\"message\":\"Deletion failed\"}";
      }
    } else {
      response = "{\"status\":\"error\",\"message\":\"Invalid ID\"}";
    }
  } else {
    response = "{\"status\":\"error\",\"message\":\"Invalid action\"}";
  }
  server.send(200, "application/json", response);
}

String enrollFingerprint(uint8_t id) {
  Serial.println("Enrolling ID #" + String(id));
  display.clearDisplay();
  display.setTextSize(2); // Bold text
  display.setCursor(0, 0);
  display.print(F("Enroll #"));
  display.println(id);
  display.drawBitmap(32, 16, FinPr_scan_bits, FinPr_scan_width, FinPr_scan_height, SSD1306_WHITE); // Scan icon
  display.display();

  int p = -1;
  Serial.println("Place finger...");
  display.clearDisplay();
  display.setTextSize(2); // Bold text
  display.setCursor(0, 0);
  display.println(F("Place Finger"));
  display.drawBitmap(32, 16, FinPr_start_bits, FinPr_start_width, FinPr_start_height, SSD1306_WHITE); // Start icon
  display.display();
  unsigned long startTime = millis();
  while (p != FINGERPRINT_OK && millis() - startTime < 60000) {
    p = finger.getImage();
    if (p == FINGERPRINT_OK) {
      Serial.println("Image taken");
      display.clearDisplay();
      display.setTextSize(2); // Bold text
      display.setCursor(0, 0);
      display.println(F("Image OK"));
      display.drawBitmap(32, 16, FinPr_valid_bits, FinPr_valid_width, FinPr_valid_height, SSD1306_WHITE); // Valid icon
      display.display();
    } else if (p == FINGERPRINT_NOFINGER) {
      delay(100);
    } else {
      Serial.println("Image error: " + String(p));
      display.clearDisplay();
      display.setTextSize(2); // Bold text
      display.setCursor(0, 0);
      display.println(F("Image Err"));
      display.drawBitmap(32, 16, FinPr_failed_bits, FinPr_failed_width, FinPr_failed_height, SSD1306_WHITE); // Failed icon
      display.display();
      return "Image error " + String(p);
    }
  }
  if (p != FINGERPRINT_OK) {
    Serial.println("Image timeout");
    display.clearDisplay();
    display.setTextSize(2); // Bold text
    display.setCursor(0, 0);
    display.println(F("Timeout"));
    display.drawBitmap(32, 16, FinPr_failed_bits, FinPr_failed_width, FinPr_failed_height, SSD1306_WHITE); // Failed icon
    display.display();
    return "Image timeout";
  }

  p = finger.image2Tz(1);
  if (p != FINGERPRINT_OK) {
    Serial.println("Conversion error: " + String(p));
    display.clearDisplay();
    display.setTextSize(2); // Bold text
    display.setCursor(0, 0);
    display.println(F("Conv Err"));
    display.drawBitmap(32, 16, FinPr_failed_bits, FinPr_failed_width, FinPr_failed_height, SSD1306_WHITE); // Failed icon
    display.display();
    return "Conversion error " + String(p);
  }

  Serial.println("Remove finger");
  display.clearDisplay();
  display.setTextSize(2); // Bold text
  display.setCursor(0, 0);
  display.println(F("Remove"));
  display.drawBitmap(32, 16, FinPr_start_bits, FinPr_start_width, FinPr_start_height, SSD1306_WHITE); // Start icon
  display.display();
  delay(2000);
  p = 0;
  while (p != FINGERPRINT_NOFINGER && millis() - startTime < 60000) {
    p = finger.getImage();
  }

  Serial.println("Place same finger again");
  display.clearDisplay();
  display.setTextSize(2); // Bold text
  display.setCursor(0, 0);
  display.println(F("Place Again"));
  display.drawBitmap(32, 16, FinPr_start_bits, FinPr_start_width, FinPr_start_height, SSD1306_WHITE); // Start icon
  display.display();
  p = -1;
  while (p != FINGERPRINT_OK && millis() - startTime < 60000) {
    p = finger.getImage();
    if (p == FINGERPRINT_OK) {
      Serial.println("Image taken");
      display.clearDisplay();
      display.setTextSize(2); // Bold text
      display.setCursor(0, 0);
      display.println(F("Image OK"));
      display.drawBitmap(32, 16, FinPr_valid_bits, FinPr_valid_width, FinPr_valid_height, SSD1306_WHITE); // Valid icon
      display.display();
    } else if (p == FINGERPRINT_NOFINGER) {
      delay(100);
    } else {
      Serial.println("Second image error: " + String(p));
      display.clearDisplay();
      display.setTextSize(2); // Bold text
      display.setCursor(0, 0);
      display.println(F("Image Err"));
      display.drawBitmap(32, 16, FinPr_failed_bits, FinPr_failed_width, FinPr_failed_height, SSD1306_WHITE); // Failed icon
      display.display();
      return "Second image error " + String(p);
    }
  }
  if (p != FINGERPRINT_OK) {
    Serial.println("Second image timeout");
    display.clearDisplay();
    display.setTextSize(2); // Bold text
    display.setCursor(0, 0);
    display.println(F("Timeout"));
    display.drawBitmap(32, 16, FinPr_failed_bits, FinPr_failed_width, FinPr_failed_height, SSD1306_WHITE); // Failed icon
    display.display();
    return "Second image timeout";
  }

  p = finger.image2Tz(2);
  if (p != FINGERPRINT_OK) {
    Serial.println("Second conversion error: " + String(p));
    display.clearDisplay();
    display.setTextSize(2); // Bold text
    display.setCursor(0, 0);
    display.println(F("Conv Err"));
    display.drawBitmap(32, 16, FinPr_failed_bits, FinPr_failed_width, FinPr_failed_height, SSD1306_WHITE); // Failed icon
    display.display();
    return "Second conversion error " + String(p);
  }

  p = finger.createModel();
  if (p != FINGERPRINT_OK) {
    Serial.println("Model error: " + String(p));
    display.clearDisplay();
    display.setTextSize(2); // Bold text
    display.setCursor(0, 0);
    display.println(F("Model Err"));
    display.drawBitmap(32, 16, FinPr_failed_bits, FinPr_failed_width, FinPr_failed_height, SSD1306_WHITE); // Failed icon
    display.display();
    return "Model error " + String(p);
  }

  p = finger.storeModel(id);
  if (p == FINGERPRINT_OK) {
    Serial.println("Stored ID #" + String(id));
    display.clearDisplay();
    display.setTextSize(2); // Bold text
    display.setCursor(0, 0);
    display.print(F("Stored #"));
    display.println(id);
    display.drawBitmap(32, 16, FinPr_valid_bits, FinPr_valid_width, FinPr_valid_height, SSD1306_WHITE); // Valid icon
    display.display();
    return "success";
  } else {
    Serial.println("Storage error: " + String(p));
    display.clearDisplay();
    display.setTextSize(2); // Bold text
    display.setCursor(0, 0);
    display.println(F("Store Err"));
    display.drawBitmap(32, 16, FinPr_failed_bits, FinPr_failed_width, FinPr_failed_height, SSD1306_WHITE); // Failed icon
    display.display();
    return "Storage error " + String(p);
  }
}

bool markAttendance() {
  Serial.println("Marking attendance...");
  display.clearDisplay();
  display.setTextSize(2); // Bold text
  display.setCursor(0, 0);
  display.println(F("Place Finger"));
  display.drawBitmap(32, 16, FinPr_start_bits, FinPr_start_width, FinPr_start_height, SSD1306_WHITE); // Start icon
  display.display();

  int p = -1;
  unsigned long startTime = millis();
  while (p != FINGERPRINT_OK && millis() - startTime < 60000) {
    p = finger.getImage();
    if (p == FINGERPRINT_OK) {
      Serial.println("Image taken");
      display.clearDisplay();
      display.setTextSize(2); // Bold text
      display.setCursor(0, 0);
      display.println(F("Image OK"));
      display.drawBitmap(32, 16, FinPr_scan_bits, FinPr_scan_width, FinPr_scan_height, SSD1306_WHITE); // Scan icon
      display.display();
    } else if (p == FINGERPRINT_NOFINGER) {
      delay(100);
    } else {
      Serial.println("Image error: " + String(p));
      display.clearDisplay();
      display.setTextSize(2); // Bold text
      display.setCursor(0, 0);
      display.println(F("Image Err"));
      display.drawBitmap(32, 16, FinPr_failed_bits, FinPr_failed_width, FinPr_failed_height, SSD1306_WHITE); // Failed icon
      display.display();
      return false;
    }
  }
  if (p != FINGERPRINT_OK) {
    Serial.println("Image timeout");
    display.clearDisplay();
    display.setTextSize(2); // Bold text
    display.setCursor(0, 0);
    display.println(F("Timeout"));
    display.drawBitmap(32, 16, FinPr_failed_bits, FinPr_failed_width, FinPr_failed_height, SSD1306_WHITE); // Failed icon
    display.display();
    return false;
  }

  p = finger.image2Tz();
  if (p != FINGERPRINT_OK) {
    Serial.println("Conversion error: " + String(p));
    display.clearDisplay();
    display.setTextSize(2); // Bold text
    display.setCursor(0, 0);
    display.println(F("Conv Err"));
    display.drawBitmap(32, 16, FinPr_failed_bits, FinPr_failed_width, FinPr_failed_height, SSD1306_WHITE); // Failed icon
    display.display();
    return false;
  }

  p = finger.fingerFastSearch();
  if (p == FINGERPRINT_OK) {
    Serial.println("Found ID #" + String(finger.fingerID));
    display.clearDisplay();
    display.setTextSize(2); // Bold text
    display.setCursor(0, 0);
    display.print(F("Found #"));
    display.println(finger.fingerID);
    display.drawBitmap(32, 16, FinPr_valid_bits, FinPr_valid_width, FinPr_valid_height, SSD1306_WHITE); // Valid icon
    display.display();
    return true;
  } else {
    Serial.println("Fingerprint not found");
    display.clearDisplay();
    display.setTextSize(2); // Bold text
    display.setCursor(0, 0);
    display.println(F("Not Found"));
    display.drawBitmap(32, 16, FinPr_invalid_bits, FinPr_invalid_width, FinPr_invalid_height, SSD1306_WHITE); // Invalid icon
    display.display();
    return false;
  }
}

bool deleteFingerprint(uint8_t id) {
  Serial.println("Deleting ID #" + String(id));
  display.clearDisplay();
  display.setTextSize(2); // Bold text
  display.setCursor(0, 0);
  display.print(F("Delete #"));
  display.println(id);
  display.drawBitmap(32, 16, FinPr_scan_bits, FinPr_scan_width, FinPr_scan_height, SSD1306_WHITE); // Scan icon
  display.display();

  uint8_t p = finger.deleteModel(id);
  if (p == FINGERPRINT_OK) {
    Serial.println("Deleted ID #" + String(id));
    display.clearDisplay();
    display.setTextSize(2); // Bold text
    display.setCursor(0, 0);
    display.print(F("Deleted #"));
    display.println(id);
    display.drawBitmap(32, 16, FinPr_valid_bits, FinPr_valid_width, FinPr_valid_height, SSD1306_WHITE); // Valid icon
    display.display();
    return true;
  } else {
    Serial.println("Deletion error: " + String(p));
    display.clearDisplay();
    display.setTextSize(2); // Bold text
    display.setCursor(0, 0);
    display.println(F("Delete Err"));
    display.drawBitmap(32, 16, FinPr_failed_bits, FinPr_failed_width, FinPr_failed_height, SSD1306_WHITE); // Failed icon
    display.display();
    return false;
  }
}